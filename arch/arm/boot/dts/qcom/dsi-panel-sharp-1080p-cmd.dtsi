/* Copyright (c) 2015-2016, The Linux Foundation. All rights reserved.
 *
 * This program is free software; you can redistribute it and/or modify
 * it under the terms of the GNU General Public License version 2 and
 * only version 2 as published by the Free Software Foundation.
 *
 * This program is distributed in the hope that it will be useful,
 * but WITHOUT ANY WARRANTY; without even the implied warranty of
 * MERCHANTABILITY or FITNESS FOR A PARTICULAR PURPOSE.  See the
 * GNU General Public License for more details.
 */

&mdss_mdp {
	dsi_sharp_1080_cmd: qcom,mdss_dsi_sharp_1080p_cmd {
		qcom,mdss-dsi-panel-name = "sharp 1080p cmd mode dsi panel";
		qcom,mdss-dsi-panel-controller = <&mdss_dsi0>;
		qcom,mdss-dsi-panel-type = "dsi_cmd_mode";
		qcom,mdss-dsi-panel-destination = "display_1";
		qcom,mdss-dsi-panel-framerate = <60>;
		qcom,mdss-dsi-virtual-channel-id = <0>;
		qcom,mdss-dsi-stream = <0>;
		qcom,mdss-dsi-panel-width = <1080>;
		qcom,mdss-dsi-panel-height = <1920>;
		qcom,mdss-dsi-h-front-porch = <0>;
		qcom,mdss-dsi-h-back-porch = <0>;
		qcom,mdss-dsi-h-pulse-width = <0>;
		qcom,mdss-dsi-h-sync-skew = <0>;
		qcom,mdss-dsi-v-back-porch = <0>;
		qcom,mdss-dsi-v-front-porch = <0>;
		qcom,mdss-dsi-v-pulse-width = <0>;
		qcom,mdss-dsi-h-left-border = <0>;
		qcom,mdss-dsi-h-right-border = <0>;
		qcom,mdss-dsi-v-top-border = <0>;
		qcom,mdss-dsi-v-bottom-border = <0>;
		qcom,mdss-dsi-bpp = <24>;
		qcom,mdss-dsi-underflow-color = <0xff>;
		qcom,mdss-dsi-border-color = <0>;
		qcom,mdss-dsi-reset-sequence = <1 10>, <0 10>, <1 10>;
		qcom,mdss-dsi-on-command = [
			39 01 00 00 00 00 02 35 00
			39 01 00 00 00 00 02 36 00
			39 01 00 00 00 00 02 3A 77
			39 01 00 00 00 00 05 2A 00 00 04 37 //set column address
			39 01 00 00 00 00 05 2B 00 00 07 7F //set page address
			39 01 00 00 00 00 03 44 00 00

			39 01 00 00 00 00 02 51 FF//write CABC
			39 01 00 00 00 00 02 53 24
			39 01 00 00 00 00 02 55 00
			39 01 00 00 80 00 02 11 00//Sleep out

			29 01 00 00 00 00 02 b0 04
			29 01 00 00 00 00 1a ce 55 40 49 53 59 5E 63 68 6E 74 7E 8A 98 A8 BB D0 FF 04 00 04 04 42 04 69 5A
			29 01 00 00 00 00 08 b8 57 3d 09 1e 00 00 00
			29 01 00 00 00 00 08 b9 6f 3d 14 3c 00 00 00
			29 01 00 00 00 00 08 ba b5 33 2a 64 00 00 00

		        39 01 00 00 00 00 02 2C 00
		        39 01 00 00 00 00 02 29 00
					];
		qcom,mdss-dsi-off-command = [
			05 01 00 00 10 00 01 28
			05 01 00 00 40 00 01 10];
		qcom,mdss-dsi-on-command-state = "dsi_lp_mode";
		qcom,mdss-dsi-off-command-state = "dsi_hs_mode";
		qcom,mdss-dsi-h-sync-pulse = <0>;
		qcom,mdss-dsi-traffic-mode = "burst_mode";
		qcom,mdss-dsi-bllp-eof-power-mode;
		qcom,mdss-dsi-bllp-power-mode;
		qcom,mdss-dsi-lane-0-state;
		qcom,mdss-dsi-lane-1-state;
		qcom,mdss-dsi-lane-2-state;
		qcom,mdss-dsi-lane-3-state;
		qcom,mdss-dsi-panel-timings = [e7 36 24 00 66 6a 2a 3a 2d 03 04
			00];
		qcom,mdss-dsi-t-clk-post = <0x0d>;
		qcom,mdss-dsi-t-clk-pre = <0x2e>;
		qcom,mdss-dsi-dma-trigger = "trigger_sw";
		qcom,mdss-dsi-mdp-trigger = "none";
		qcom,mdss-dsi-bl-pmic-control-type = "bl_ctrl_pwm";
		qcom,mdss-dsi-te-pin-select = <1>;
		qcom,mdss-dsi-wr-mem-start = <0x2c>;
		qcom,mdss-dsi-wr-mem-continue = <0x3c>;
		qcom,mdss-dsi-te-dcs-command = <1>;
		qcom,mdss-dsi-te-check-enable;
		qcom,mdss-dsi-te-using-te-pin;
	};
};
